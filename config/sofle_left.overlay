#include <dt-bindings/led/led.h>

/ {
    chosen {
        zmk,underglow = &rgb_underglow;
    };

    rgb_underglow: ws2812 {
        compatible = "worldsemi,ws2812-spi";
        chain-length = <29>;
        spi-dev = <&spi1>;
        spi-cpol;
        spi-cpha;
    };
};
